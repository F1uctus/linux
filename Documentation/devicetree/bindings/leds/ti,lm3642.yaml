## Documentation/devicetree/bindings/leds/ti,lm3642.yaml
```yaml
# SPDX-License-Identifier: (GPL-2.0-only OR BSD-2-Clause)
%YAML 1.2
---
$id: http://devicetree.org/schemas/leds/ti,lm3642.yaml#
$schema: http://devicetree.org/meta-schemas/core.yaml#

title: TI LM3642 1.5A Synchronous Boost Flash LED Driver

maintainers:
  - Ilya I. Nikitin <ilya.i.nikitin@proton.me>

description:
  The LM3642 drives a single white LED in flash, torch and indicator modes
  over I2C. Flash and torch are exposed as one flash class device, the
  indicator as a plain LED.

properties:
  compatible:
    const: ti,lm3642

  reg:
    const: 0x63

  led-flash:
    type: object
    $ref: /schemas/leds/common.yaml#
    unevaluatedProperties: false

    properties:
      led-max-microamp:
        maximum: 375000

      flash-max-microamp:
        maximum: 1500000

      flash-max-timeout-us:
        maximum: 800000

  led-indicator:
    type: object
    $ref: /schemas/leds/common.yaml#
    unevaluatedProperties: false

required:
  - compatible
  - reg
  - led-flash

additionalProperties: false

examples:
  - |
    #include <dt-bindings/leds/common.h>

    i2c {
        #address-cells = <1>;
        #size-cells = <0>;

        led-controller@63 {
            compatible = "ti,lm3642";
            reg = <0x63>;

            led-flash {
                function = LED_FUNCTION_FLASH;
                color = <LED_COLOR_ID_WHITE>;
                led-max-microamp = <375000>;
                flash-max-microamp = <1500000>;
                flash-max-timeout-us = <800000>;
            };

            led-indicator {
                function = LED_FUNCTION_INDICATOR;
                color = <LED_COLOR_ID_WHITE>;
            };
        };
    };
...
```

## Documentation/devicetree/bindings/media/i2c/rohm,bu64291.yaml
```yaml
# SPDX-License-Identifier: GPL-2.0-only OR BSD-2-Clause
%YAML 1.2
---
$id: http://devicetree.org/schemas/media/i2c/rohm,bu64291.yaml#
$schema: http://devicetree.org/meta-schemas/core.yaml#

title: ROHM BU64291GWZ camera voice coil lens driver

maintainers:
  - Ilya I. Nikitin <ilya.i.nikitin@proton.me>

description:
  BU64291GWZ is a 10-bit DAC driving a voice coil lens actuator with
  resonance suppression. It is intended for autofocus in camera modules.

properties:
  compatible:
    const: rohm,bu64291

  reg:
    maxItems: 1

  vcc-supply:
    description: VDD power supply

required:
  - compatible
  - reg
  - vcc-supply

additionalProperties: false

examples:
  - |
    i2c {
        #address-cells = <1>;
        #size-cells = <0>;

        camera-lens@c {
            compatible = "rohm,bu64291";
            reg = <0x0c>;
            vcc-supply = <&reg_vaf_2v8>;
        };
    };
...
```

## Documentation/devicetree/bindings/media/i2c/samsung,s5k5e2.yaml
```yaml
# SPDX-License-Identifier: (GPL-2.0-only OR BSD-2-Clause)
%YAML 1.2
---
$id: http://devicetree.org/schemas/media/i2c/samsung,s5k5e2.yaml#
$schema: http://devicetree.org/meta-schemas/core.yaml#

title: Samsung S5K5E2 Image Sensor

description:
  Samsung S5K5E2 (ISOCELL 5E2) image sensor is a 5MP image sensor.
  The sensor is controlled over a serial camera control bus protocol,
  the widest supported output image frame size is 2560x1920 at 30 frames
  per second, data output format is RAW10 transferred over 2-lane
  MIPI D-PHY interface.

maintainers:
  - Ilya I. Nikitin <ilya.i.nikitin@proton.me>

allOf:
  - $ref: /schemas/media/video-interface-devices.yaml#

properties:
  compatible:
    const: samsung,s5k5e2

  reg:
    maxItems: 1

  clocks:
    description: MCLK supply clock.
    maxItems: 1

  reset-gpios:
    description: Active low GPIO connected to RESET pad of the sensor.
    maxItems: 1

  vdda-supply:
    description: Analogue voltage supply, 2.8 volts.

  vddd-supply:
    description: Digital core voltage supply, 1.8 volts.

  vddio-supply:
    description: Digital I/O voltage supply, 1.8 volts.

  port:
    $ref: /schemas/graph.yaml#/$defs/port-base
    additionalProperties: false

    properties:
      endpoint:
        $ref: /schemas/media/video-interfaces.yaml#
        unevaluatedProperties: false

        properties:
          data-lanes:
            items:
              - const: 1
              - const: 2

        required:
          - link-frequencies

required:
  - compatible
  - reg
  - clocks
  - port

unevaluatedProperties: false

examples:
  - |
      #include <dt-bindings/gpio/gpio.h>

      i2c {
          #address-cells = <1>;
          #size-cells = <0>;

          camera@10 {
              compatible = "samsung,s5k5e2";
              reg = <0x10>;
              clocks = <&camera_mclk 1>;
              assigned-clocks = <&camera_mclk 1>;
              assigned-clock-rates = <24000000>;
              reset-gpios = <&gpio1 28 GPIO_ACTIVE_LOW>;
              vdda-supply = <&vreg_2p8>;
              vddd-supply = <&vreg_1p8>;
              vddio-supply = <&vreg_1p8>;

              port {
                  endpoint {
                      data-lanes = <1 2>;
                      link-frequencies = /bits/ 64 <448000000>;
                      remote-endpoint = <&mipi_csi2_ep>;
                  };
              };
          };
      };
...
```

## drivers/iio/common/cwstm32/Kconfig
```kconfig
# SPDX-License-Identifier: GPL-2.0-only
#
# CyWee CWSTM32 sensor hub
#

config IIO_CWSTM32
	tristate "CyWee CWSTM32 sensor hub"
	depends on I2C
	help
	  Say yes here to build support for the CyWee STM32 sensor hub found
	  on the ZTE Blade S6, which aggregates accelerometer, gyroscope,
	  magnetometer, ambient light and proximity sensors behind an I2C
	  register protocol and exposes them as IIO channels.
```
